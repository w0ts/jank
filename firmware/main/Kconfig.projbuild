## firmware/main/Kconfig.projbuild
```kconfig
menu "jank"
    choice JANK_BOARD
        prompt "Board"
        default JANK_BOARD_XIAO
        config JANK_BOARD_XIAO
            bool "Seeed XIAO ESP32S3"
            depends on IDF_TARGET_ESP32S3
        config JANK_BOARD_MINI22
            bool "jank mini 2.2 (ESP32-S3FH4R2): USB host mode's parts; a build check until the board exists"
            depends on IDF_TARGET_ESP32S3
        config JANK_BOARD_LCD2
            bool "Waveshare ESP32-S3-LCD-2 (240 x 320 ST7789 in landscape; docs/lcd2.md): a build check until it runs"
            depends on IDF_TARGET_ESP32S3
    endchoice

    config JANK_LCD_MIRROR_X
        bool "LCD2: mirror the landscape picture left to right"
        depends on JANK_BOARD_LCD2
        default y
        help
            Which of the four landscape orientations puts the picture upright for the way the board is held is not known
            until it is on a bench (docs/lcd2.md, UNVERIFIED): these two switches turn it without touching the code.

    config JANK_LCD_MIRROR_Y
        bool "LCD2: mirror the landscape picture top to bottom"
        depends on JANK_BOARD_LCD2
        default n

    config JANK_UI_BENCH
        bool "XIAO UI bench: a 128 x 64 I2C OLED on D4 / D5 and four buttons on D3 / D8 / D9 / D10"
        depends on JANK_BOARD_XIAO
        default n
        help
            The device's own screen and D-pad on a XIAO, to try the mini 2.2's user interface (main/board.h has the pads):
            an SSD1309 (or SSD1306) module at 0x3C / 0x3D on SDA D4 = GPIO5, SCL D5 = GPIO6, and buttons to GND:
            UP D3 = GPIO4, DOWN D8 = GPIO7, YES D9 = GPIO8, NO D10 = GPIO9 (or the BOOT button). Off: the XIAO as it was.

    config JANK_UI_BENCH_SSD1306
        bool "The bench's module is an SSD1306 (its charge pump switched on)"
        depends on JANK_UI_BENCH
        default n
        help
            The common 0.96" / 1.3"-class SSD1306 modules make their panel voltage with the controller's own charge pump
            (command 8D 14); an SSD1309 has none (its module has a boost converter) and the command is not sent to it.
    config JANK_LINEIN_BENCH
        bool "XIAO bench LINE IN on pad D3 (GPIO4, ADC1_CH3)"
        depends on JANK_BOARD_XIAO && !JANK_UI_BENCH
        default n
        help
            The XIAO has no LINE IN. This samples pad D3 (GPIO4) with the LINE IN path (main/linein.c) so it can be tried
            on the bench: a line signal through a bias network to D3 (docs/linein.md), then `set source line`. Off in the
            normal XIAO build (USB audio only). firmware/sdkconfig.linein-bench turns it on.
endmenu
```

## tools/powerprobe/sdkconfig.defaults
```kconfig
CONFIG_IDF_TARGET="esp32s3"
CONFIG_ESPTOOLPY_FLASHSIZE_8MB=y
CONFIG_ESP_CONSOLE_USB_SERIAL_JTAG=y
CONFIG_ESP_DEFAULT_CPU_FREQ_MHZ_80=y
CONFIG_ESP_PHY_CALIBRATION_AND_DATA_STORAGE=y
CONFIG_ESP_WIFI_IRAM_OPT=n
```
