## firmware/main/Kconfig.projbuild
```kconfig
menu "jank"
    choice JANK_BOARD
        prompt "Board"
        default JANK_BOARD_XIAO
        config JANK_BOARD_XIAO
            bool "Seeed XIAO ESP32S3"
            depends on IDF_TARGET_ESP32S3
    endchoice
endmenu
```
